## meta-orangepi/conf/layer.conf
```bitbake
# Orange Pi board support for OpenBMC.
BBPATH .= ":${LAYERDIR}"

BBFILES += "${LAYERDIR}/recipes*/*/*.bb \
            ${LAYERDIR}/recipes*/*/*.bbappend"

BBFILE_COLLECTIONS += "orangepi"
BBFILE_PATTERN_orangepi := "^${LAYERDIR}/"
BBFILE_PRIORITY_orangepi = "12"

LAYERSERIES_COMPAT_orangepi = "wrynose"
LAYERDEPENDS_orangepi = "core openembedded-layer"
```
